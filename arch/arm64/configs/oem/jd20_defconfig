## arch/arm64/configs/oem/jd20_defconfig
```kconfig
#CONFIG_PRODUCT_JD20=y
#CONFIG_TOUCHSCREEN_FTS=y
#CONFIG_MMC_SDHCI_MSM_BH201=y
#CONFIG_INPUT_FINGERPRINT=y
#CONFIG_GOODIX_FINGERPRINT=y
#CONFIG_TOUCHSCREEN_SYNAPTICS_DSX=y
#CONFIG_TOUCHSCREEN_SYNAPTICS_DSX_CORE=y
#CONFIG_TOUCHSCREEN_SYNAPTICS_DSX_RMI_DEV=y
#CONFIG_TOUCHSCREEN_SYNAPTICS_DSX_FW_UPDATE=y
#CONFIG_TOUCHSCREEN_SYNAPTICS_DSX_TEST_REPORTING=y
# CONFIG TOUCHSCREEN_SYNAPTICS_DSX_FW_UPDATE_EXTRA_SYSFS is not set
# CONFIG TOUCHSCREEN_SYNAPTICS_DSX_PROXIMITY is not set
# CONFIG TOUCHSCREEN_SYNAPTICS_DSX_ACTIVE_PEN is not set
# CONFIG TOUCHSCREEN_SYNAPTICS_DSX_GESTURE is not set
# CONFIG TOUCHSCREEN_SYNAPTICS_DSX_VIDEO is not set
# CONFIG TOUCHSCREEN_SYNAPTICS_DSX_DEBUG is not set
#CONFIG_NETFILTER_XT_MATCH_QTAGUID_EXT=y
#CONFIG_NETFILTER_XT_MATCH_TLV=y
#CONFIG_NETFILTER_XT_TARGET_TCPOPTSTRIP=y

#CONFIG_CPU_FREQ_STAT=y
#CONFIG_CPU_FREQ_TIMES=y
```

## drivers/input/fingerprint/Kconfig
```kconfig
menuconfig INPUT_FINGERPRINT
	bool "Fingerprint"
	help
	  Say Y here, and a list of supported fingerprint will be displayed.
	  This option doesn't affect the kernel.

	  If unsure, say Y.

#source "goodixfp/Kconfig"
config GOODIX_FINGERPRINT
	tristate "generic goodix fingerprint driver"
	default n 
	help
	add support for goodix fingerprint driver.
```
