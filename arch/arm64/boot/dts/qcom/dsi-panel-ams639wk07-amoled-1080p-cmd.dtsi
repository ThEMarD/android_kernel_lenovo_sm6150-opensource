/* Copyright (c) 2018, The Linux Foundation. All rights reserved.
 *
 * This program is free software; you can redistribute it and/or modify
 * it under the terms of the GNU General Public License version 2 and
 * only version 2 as published by the Free Software Foundation.
 *
 * This program is distributed in the hope that it will be useful,
 * but WITHOUT ANY WARRANTY; without even the implied warranty of
 * MERCHANTABILITY or FITNESS FOR A PARTICULAR PURPOSE.  See the
 * GNU General Public License for more details.
 */

&mdss_mdp {
	dsi_ams639wk07_amoled_1080p_cmd: qcom,mdss_dsi_ams639wk07_amoled_1080p_cmd {
		qcom,mdss-dsi-panel-name = "ams639wk07 amoled cmd mode dsi tm panel with DSC";
		qcom,mdss-dsi-panel-type = "dsi_cmd_mode";
		qcom,mdss-dsi-virtual-channel-id = <0>;
		qcom,mdss-dsi-stream = <0>;
		qcom,mdss-dsi-bpp = <24>;
		qcom,mdss-dsi-color-order = "rgb_swap_rgb";
		qcom,mdss-dsi-underflow-color = <0xff>;
		qcom,mdss-dsi-border-color = <0>;
		qcom,mdss-dsi-traffic-mode = "non_burst_sync_event";
		qcom,mdss-dsi-lane-map = "lane_map_0123";
		qcom,mdss-dsi-lane-0-state;
		qcom,mdss-dsi-lane-1-state;
		qcom,mdss-dsi-lane-2-state;
		qcom,mdss-dsi-lane-3-state;
		qcom,mdss-dsi-dma-trigger = "trigger_sw";
		qcom,mdss-dsi-mdp-trigger = "none";
		qcom,mdss-dsi-reset-sequence = <1 10>, <0 10>, <1 10>;
		qcom,mdss-dsi-te-pin-select = <10>;
		qcom,mdss-dsi-te-dcs-command = <1>;
		qcom,mdss-dsi-te-check-enable;
		qcom,mdss-dsi-te-using-te-pin;
		qcom,mdss-dsi-panel-clockrate = <1107000000>;
		qcom,mdss-dsi-lp11-init;
		qcom,mdss-dsi-hbm-cmd-enable;

                qcom,mdss-dsi-panel-hdr-enabled;
                qcom,mdss-dsi-panel-hdr-color-primaries = <14860 15895 34225
                        15675 12860 35350 6895 2150>;
                qcom,mdss-dsi-panel-peak-brightness = <5300000>;
                qcom,mdss-dsi-panel-blackness-level = <100>;

		qcom,mdss-dsi-display-timings {
			timing@0{
				qcom,mdss-dsi-panel-framerate = <60>;
				qcom,mdss-dsi-panel-width = <1080>;
				qcom,mdss-dsi-panel-height = <2340>;
				qcom,mdss-dsi-h-front-porch = <44>;
				qcom,mdss-dsi-h-back-porch = <32>;
				qcom,mdss-dsi-h-pulse-width = <12>;
				qcom,mdss-dsi-h-sync-skew = <0>;
				qcom,mdss-dsi-h-sync-pulse = <0>;
				qcom,mdss-dsi-v-back-porch = <25>;
				qcom,mdss-dsi-v-front-porch = <25>;
				qcom,mdss-dsi-v-pulse-width = <4>;
				qcom,mdss-dsi-h-left-border = <0>;
				qcom,mdss-dsi-h-right-border = <0>;
				qcom,mdss-dsi-v-top-border = <0>;
				qcom,mdss-dsi-v-bottom-border = <0>;
				qcom,mdss-dsi-panel-jitter = <0x5 0x1>;
				qcom,mdss-dsi-on-command = [
					05 01 00 00 0A 00 01 11
					39 00 00 00 00 00 03 F0 5A 5A
					15 00 00 00 00 00 02 35 00
					39 00 00 00 00 00 03 F0 A5 A5
					39 00 00 00 00 00 05 2B 00 00 09 23
					15 00 00 00 00 00 02 53 20
					39 00 00 00 00 00 03 51 03 FF
					15 00 00 00 78 00 02 55 00
					05 01 00 00 00 00 01 29];
				qcom,mdss-dsi-off-command = [
					05 01 00 00 23 00 01 28
					05 01 00 00 78 00 01 10];
				qcom,mdss-dsi-hbm-on-command = [
					15 01 00 00 00 00 02 53 E0];
				qcom,mdss-dsi-hbm-off-command = [
					15 01 00 00 00 00 02 53 20];
				qcom,mdss-dsi-lp1-command = [
					15 00 00 00 00 00 02 53 23];
				qcom,mdss-dsi-nolp-command = [
					15 00 00 00 00 00 02 53 20];
				qcom,mdss-dsi-on-command-state = "dsi_lp_mode";
				qcom,mdss-dsi-off-command-state = "dsi_hs_mode";
				qcom,mdss-dsi-hbm-on-state = "dsi_hs_mode";
				qcom,mdss-dsi-hbm-off-state = "dsi_hs_mode";
				qcom,mdss-dsi-lp1-command-state = "dsi_lp_mode";
				qcom,mdss-dsi-nolp-command-state = "dsi_lp_mode";
			};
		};
	};
};
