/* Copyright (c) 2016-2017, The Linux Foundation. All rights reserved.
 *
 * This program is free software; you can redistribute it and/or modify
 * it under the terms of the GNU General Public License version 2 and
 * only version 2 as published by the Free Software Foundation.
 *
 * This program is distributed in the hope that it will be useful,
 * but WITHOUT ANY WARRANTY; without even the implied warranty of
 * MERCHANTABILITY or FITNESS FOR A PARTICULAR PURPOSE.  See the
 * GNU General Public License for more details.
 */

#include "lenovo-jd20-goodixfp.dtsi"

&qupv3_se7_i2c{
	qcom,i2c-touch-active="synaptics,dsx-i2c";
	status = "ok";

	focaltech@38{
        	status = "ok";
        	compatible = "focaltech,fts";
        	reg = <0x38>;
        	interrupt-parent = <&tlmm>;
        	interrupts = <9 0x2002>;
        	vdd-supply = <&pm6150l_l7>;
        	vcc_i2c-supply = <&pm6150_l10>;
        	focaltech,reset-gpio = <&tlmm 8 0x00>;
        	focaltech,irq-gpio = <&tlmm 9 0x2002>;
        	focaltech,max-touch-number = <10>;
        	focaltech,display-coords =  <0 0 1080 2340>;
        	//pinctrl-names = "pmx_ts_active","pmx_ts_suspend","pmx_ts_release";
        	//pinctrl-0 = <&ts_int_active &ts_reset_active>;
        	//pinctrl-1 = <&ts_int_suspend &ts_reset_suspend>;
        	//pinctrl-2 = <&ts_release>;
        	//focaltech,have-key;
        	//focaltech,key-number = <3>;
        	//focaltech,keys = <139 102 158>;
        	//focaltech,key-y-coord = <2000>;
        	//focaltech,key-x-coords = <200 600 800>;
	};

	synaptics_dsx@20 {
		compatible = "synaptics,dsx-i2c";
		reg = <0x20>;
		interrupt-parent = <&tlmm>;
		interrupts = <9 0x2008>;
		vdd-supply = <&pm6150l_l7>;
		avdd-supply = <&pm6150_l10>;
		pinctrl-names = "pmx_ts_active","pmx_ts_suspend",
					"pmx_ts_release";
		pinctrl-0 = <&ts_active>;
		pinctrl-1 = <&ts_int_suspend &ts_reset_suspend>;
		pinctrl-2 = <&ts_release>;
		synaptics,pwr-reg-name = "avdd";
		synaptics,bus-reg-name = "vdd";
		synaptics,ub-i2c-addr = <0x20>;
		synaptics,max-y-for-2d = <2340>;
		synaptics,irq-gpio = <&tlmm 9 0x2008>;
		synaptics,reset-gpio = <&tlmm 8 0x0>;
		synaptics,irq-on-state = <0>;
		synaptics,power-delay-ms = <200>;
		synaptics,reset-delay-ms = <50>;
		synaptics,reset-on-state = <0>;
		synaptics,reset-active-ms = <20>;
	};
};

&sdhc_2 {
	cd-gpios = <&tlmm 69 GPIO_ACTIVE_LOW>;
};
